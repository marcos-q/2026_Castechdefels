#include <Wire.h>
#include <Adafruit_GFX.h>
#include <Adafruit_SSD1306.h>

#define SCREEN_WIDTH 128
#define SCREEN_HEIGHT 64
Adafruit_SSD1306 display(SCREEN_WIDTH, SCREEN_HEIGHT, &Wire, -1);

// --- ASSIGNACIÓ DE PINS (Es mantenen per a futures ampliacions) ---
const int PIN_SDA = 3;   
const int PIN_SCL = 4;
const int PIN_BTN_A = 6; 
const int PIN_BTN_B = 7;  
const int PIN_LDR = 0;    
const int LED_R = 21;    
const int LED_G = 20;    
const int LED_B = 10;

// ========================================================
// BITMAPS DELS ULLS (32x48 píxels) - 192 bytes cadascun
// ========================================================

const unsigned char ullNormal[] PROGMEM = {
  0x00, 0x00, 0x00, 0x00, 0x00, 0x00, 0x00, 0x00, 0x00, 0x00, 0x00, 0x00, 0x00, 0x00, 0x00, 0x00, 
  0x07, 0xFF, 0xFF, 0xE0, 0x0F, 0xFF, 0xFF, 0xF0, 0x1F, 0xFF, 0xFF, 0xF8, 0x3F, 0xFF, 0xFF, 0xFC,
  0x3F, 0xFF, 0xFF, 0xFC, 0x3F, 0xFF, 0xFF, 0xFC, 0x3F, 0xFF, 0xFF, 0xFC, 0x3F, 0xFF, 0xFF, 0xFC,
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  0x00, 0x00, 0x00, 0x00, 0x00, 0x00, 0x00, 0x00, 0x00, 0x00, 0x00, 0x00, 0x00, 0x00, 0x00, 0x00
};

const unsigned char ullParpelleig[] PROGMEM = {
  0x00, 0x00, 0x00, 0x00, 0x00, 0x00, 0x00, 0x00, 0x00, 0x00, 0x00, 0x00, 0x00, 0x00, 0x00, 0x00,
  0x00, 0x00, 0x00, 0x00, 0x00, 0x00, 0x00, 0x00, 0x00, 0x00, 0x00, 0x00, 0x00, 0x00, 0x00, 0x00,
  0x00, 0x00, 0x00, 0x00, 0x00, 0x00, 0x00, 0x00, 0x00, 0x00, 0x00, 0x00, 0x00, 0x00, 0x00, 0x00,
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  0x00, 0x00, 0x00, 0x00, 0x00, 0x00, 0x00, 0x00, 0x00, 0x00, 0x00, 0x00, 0x00, 0x00, 0x00, 0x00
};

const unsigned char ullEnfadatE[] PROGMEM = {
  0x00, 0x00, 0x00, 0x00, 0x00, 0x00, 0x00, 0x00, 0x00, 0x00, 0x00, 0x00, 0x00, 0x00, 0x00, 0x00,
  0x07, 0xFE, 0x00, 0x00, 0x0F, 0xFF, 0x00, 0x00, 0x1F, 0xFF, 0x80, 0x00, 0x3F, 0xFF, 0xC0, 0x00,
  0x3F, 0xFF, 0xE0, 0x00, 0x3F, 0xFF, 0xF0, 0x00, 0x3F, 0xFF, 0xF8, 0x00, 0x3F, 0xFF, 0xFC, 0x00,
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  0x00, 0x00, 0x00, 0x00, 0x00, 0x00, 0x00, 0x00, 0x00, 0x00, 0x00, 0x00, 0x00, 0x00, 0x00, 0x00
};

const unsigned char ullEnfadatD[] PROGMEM = {
  0x00, 0x00, 0x00, 0x00, 0x00, 0x00, 0x00, 0x00, 0x00, 0x00, 0x00, 0x00, 0x00, 0x00, 0x00, 0x00,
  0x00, 0x00, 0x7F, 0xE0, 0x00, 0x00, 0xFF, 0xF0, 0x00, 0x01, 0xFF, 0xF8, 0x00, 0x03, 0xFF, 0xFC,
  0x00, 0x07, 0xFF, 0xFC, 0x00, 0x0F, 0xFF, 0xFC, 0x00, 0x1F, 0xFF, 0xFC, 0x00, 0x3F, 0xFF, 0xFC,
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  0x00, 0x00, 0x00, 0x00, 0x00, 0x00, 0x00, 0x00, 0x00, 0x00, 0x00, 0x00, 0x00, 0x00, 0x00, 0x00
};

const unsigned char ullTristE[] PROGMEM = {
  0x00, 0x00, 0x00, 0x00, 0x00, 0x00, 0x00, 0x00, 0x00, 0x00, 0x00, 0x00, 0x00, 0x00, 0x00, 0x00,
  0x00, 0x00, 0x7F, 0xE0, 0x00, 0x00, 0xFF, 0xF0, 0x00, 0x01, 0xFF, 0xF8, 0x00, 0x03, 0xFF, 0xFC,
  0x00, 0x07, 0xFF, 0xFC, 0x00, 0x0F, 0xFF, 0xFC, 0x00, 0x1F, 0xFF, 0xFC, 0x00, 0x3F, 0xFF, 0xFC,
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  0x00, 0x00, 0x00, 0x00, 0x00, 0x00, 0x00, 0x00, 0x00, 0x00, 0x00, 0x00, 0x00, 0x00, 0x00, 0x00
};

const unsigned char ullTristD[] PROGMEM = {
  0x00, 0x00, 0x00, 0x00, 0x00, 0x00, 0x00, 0x00, 0x00, 0x00, 0x00, 0x00, 0x00, 0x00, 0x00, 0x00,
  0x07, 0xFE, 0x00, 0x00, 0x0F, 0xFF, 0x00, 0x00, 0x1F, 0xFF, 0x80, 0x00, 0x3F, 0xFF, 0xC0, 0x00,
  0x3F, 0xFF, 0xE0, 0x00, 0x3F, 0xFF, 0xF0, 0x00, 0x3F, 0xFF, 0xF8, 0x00, 0x3F, 0xFF, 0xFC, 0x00,
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  0x00, 0x00, 0x00, 0x00, 0x00, 0x00, 0x00, 0x00, 0x00, 0x00, 0x00, 0x00, 0x00, 0x00, 0x00, 0x00
};

const unsigned char ullFelic[] PROGMEM = {
  0x00, 0x00, 0x00, 0x00, 0x00, 0x00, 0x00, 0x00, 0x00, 0x00, 0x00, 0x00, 0x00, 0x00, 0x00, 0x00,
  0x07, 0xFF, 0xFF, 0xE0, 0x0F, 0xFF, 0xFF, 0xF0, 0x1F, 0xFF, 0xFF, 0xF8, 0x3F, 0xFF, 0xFF, 0xFC,
  0x3F, 0xFF, 0xFF, 0xFC, 0x3F, 0xE0, 0x07, 0xFC, 0x3F, 0xC0, 0x03, 0xFC, 0x3F, 0x80, 0x01, 0xFC,
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  0x00, 0x00, 0x00, 0x00, 0x00, 0x00, 0x00, 0x00, 0x00, 0x00, 0x00, 0x00, 0x00, 0x00, 0x00, 0x00
};

const unsigned char ullSon[] PROGMEM = {
  0x00, 0x00, 0x00, 0x00, 0x00, 0x00, 0x00, 0x00, 0x00, 0x00, 0x00, 0x00, 0x00, 0x00, 0x00, 0x00,
  0x00, 0x00, 0x00, 0x00, 0x00, 0x00, 0x00, 0x00, 0x00, 0x00, 0x00, 0x00, 0x00, 0x00, 0x00, 0x00,
  0x00, 0x00, 0x00, 0x00, 0x00, 0x00, 0x00, 0x00, 0x00, 0x00, 0x00, 0x00, 0x00, 0x00, 0x00, 0x00,
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  0x00, 0x00, 0x00, 0x00, 0x00, 0x00, 0x00, 0x00, 0x00, 0x00, 0x00, 0x00, 0x00, 0x00, 0x00, 0x00
};

const unsigned char ullSquint[] PROGMEM = {
  0x00, 0x00, 0x00, 0x00, 0x00, 0x00, 0x00, 0x00, 0x00, 0x00, 0x00, 0x00, 0x00, 0x00, 0x00, 0x00,
  0x00, 0x00, 0x00, 0x00, 0x00, 0x00, 0x00, 0x00, 0x00, 0x00, 0x00, 0x00, 0x00, 0x00, 0x00, 0x00,
  0x00, 0x00, 0x00, 0x00, 0x00, 0x00, 0x00, 0x00, 0x00, 0x00, 0x00, 0x00, 0x00, 0x00, 0x00, 0x00,
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  0x00, 0x00, 0x00, 0x00, 0x00, 0x00, 0x00, 0x00, 0x00, 0x00, 0x00, 0x00, 0x00, 0x00, 0x00, 0x00
};

const unsigned char ullSorpres[] PROGMEM = {
  0x00, 0x00, 0x00, 0x00, 0x00, 0x00, 0x00, 0x00, 0x00, 0x00, 0x00, 0x00, 0x00, 0x00, 0x00, 0x00,
  0x00, 0x00, 0x00, 0x00, 0x00, 0x00, 0x00, 0x00, 0x00, 0x00, 0x00, 0x00, 0x00, 0x00, 0x00, 0x00,
  0x00, 0x00, 0x00, 0x00, 0x00, 0x00, 0x00, 0x00, 0x00, 0x00, 0x00, 0x00, 0x00, 0x00, 0x00, 0x00,
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  0x00, 0x00, 0x00, 0x00, 0x00, 0x00, 0x00, 0x00, 0x00, 0x00, 0x00, 0x00, 0x00, 0x00, 0x00, 0x00
};

// ========================================================
// NOVES EXPRESSIONS GENERADES (32x48 píxels)
// ========================================================

// 1. PENSANT (Dues línies horitzontals paral·leles al centre)
const unsigned char ullPensant[] PROGMEM = {
  0x00, 0x00, 0x00, 0x00, 0x00, 0x00, 0x00, 0x00, 0x00, 0x00, 0x00, 0x00, 0x00, 0x00, 0x00, 0x00,
  0x00, 0x00, 0x00, 0x00, 0x00, 0x00, 0x00, 0x00, 0x00, 0x00, 0x00, 0x00, 0x00, 0x00, 0x00, 0x00,
  0x00, 0x00, 0x00, 0x00, 0x00, 0x00, 0x00, 0x00, 0x00, 0x00, 0x00, 0x00, 0x00, 0x00, 0x00, 0x00,
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  0x00, 0x00, 0x00, 0x00, 0x00, 0x00, 0x00, 0x00, 0x00, 0x00, 0x00, 0x00, 0x00, 0x00, 0x00, 0x00
};

// 2. MAREJAT / ERROR (Ulls en forma de X)
const unsigned char ullMarejat[] PROGMEM = {
  0x00, 0x00, 0x00, 0x00, 0x00, 0x00, 0x00, 0x00, 0x00, 0x00, 0x00, 0x00, 0x00, 0x00, 0x00, 0x00,
  0xC0, 0x00, 0x00, 0x03, 0xE0, 0x00, 0x00, 0x07, 0xF0, 0x00, 0x00, 0x0F, 0x78, 0x00, 0x00, 0x1E,
  0x3C, 0x00, 0x00, 0x3C, 0x1E, 0x00, 0x00, 0x78, 0x0F, 0x00, 0x00, 0xF0, 0x07, 0x80, 0x01, 0xE0,
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  0x00, 0x00, 0x00, 0x00, 0x00, 0x00, 0x00, 0x00, 0x00, 0x00, 0x00, 0x00, 0x00, 0x00, 0x00, 0x00
};

// --- MÀQUINA D'ESTATS DE LES EXPRESSIONS (Ampliada a 11 estats) ---
enum Expressions { 
  NORMAL, PARPELLEIG, ENFADAT, FELIC, SON, TRIST, SOSPITOS, SORPRES, 
  PENSANT, WINK, MAREJAT 
};
int expressioActual = NORMAL; 
int expressioAnterior = -1;

// Coordenades X/Y
const int ULL_ESQUERRE_X = 20;
const int ULL_DRET_X     = 76;
const int ULLS_Y         = 8;

// --- VARIABLES PER AL CONTROL DE TEMPS (Automàtic) ---
unsigned long tempsUltimCanvi = 0;
const unsigned long INTERVAL_EXPRESSIO = 3000; // 3 segons per expressió

void setup() {
  Serial.begin(9600);

  // Configurem tots els pins de referència per a futures ampliacions
  pinMode(PIN_BTN_A, INPUT_PULLUP);
  pinMode(PIN_BTN_B, INPUT_PULLUP);
  pinMode(LED_R, OUTPUT); pinMode(LED_G, OUTPUT); pinMode(LED_B, OUTPUT);

  Wire.begin(PIN_SDA, PIN_SCL); 
  if(!display.begin(SSD1306_SWITCHCAPVCC, 0x3C)) {
    Serial.println("Error OLED");
    while(true); 
  }
  
  tempsUltimCanvi = millis(); 
}

void loop() {
  
  // --- 1. CONTROL TEMPORITZAT DE L'ANIMACIÓ ---
  if (millis() - tempsUltimCanvi >= INTERVAL_EXPRESSIO) {
    tempsUltimCanvi = millis(); 
    
    expressioActual++; // Avancem a la següent expressió de la llista
    if (expressioActual > MAREJAT) { // Reiniciem quan passem de l'última
      expressioActual = NORMAL; 
    }
  }

  // --- 2. DIBUIX I LEDS A PANTALLA COMPLETA ---
  display.clearDisplay();

  switch (expressioActual) {
    case NORMAL:
      if (expressioActual != expressioAnterior) Serial.println("Estat: NORMAL");
      digitalWrite(LED_R, LOW); digitalWrite(LED_G, HIGH); digitalWrite(LED_B, LOW); // Verd
      display.drawBitmap(ULL_ESQUERRE_X, ULLS_Y, ullNormal, 32, 48, SSD1306_WHITE);
      display.drawBitmap(ULL_DRET_X, ULLS_Y, ullNormal, 32, 48, SSD1306_WHITE);
      break;

    case PARPELLEIG:
      if (expressioActual != expressioAnterior) Serial.println("Estat: PARPELLEIG");
      digitalWrite(LED_R, LOW); digitalWrite(LED_G, HIGH); digitalWrite(LED_B, LOW);
      display.drawBitmap(ULL_ESQUERRE_X, ULLS_Y, ullParpelleig, 32, 48, SSD1306_WHITE);
      display.drawBitmap(ULL_DRET_X, ULLS_Y, ullParpelleig, 32, 48, SSD1306_WHITE);
      break;

    case ENFADAT:
      if (expressioActual != expressioAnterior) Serial.println("Estat: ENFADAT");
      digitalWrite(LED_R, HIGH); digitalWrite(LED_G, LOW); digitalWrite(LED_B, LOW); // Vermell
      display.drawBitmap(ULL_ESQUERRE_X, ULLS_Y, ullEnfadatE, 32, 48, SSD1306_WHITE);
      display.drawBitmap(ULL_DRET_X, ULLS_Y, ullEnfadatD, 32, 48, SSD1306_WHITE);
      break;

    case FELIC:
      if (expressioActual != expressioAnterior) Serial.println("Estat: FELIC");
      digitalWrite(LED_R, HIGH); digitalWrite(LED_G, HIGH); digitalWrite(LED_B, LOW); // Groc
      display.drawBitmap(ULL_ESQUERRE_X, ULLS_Y, ullFelic, 32, 48, SSD1306_WHITE);
      display.drawBitmap(ULL_DRET_X, ULLS_Y, ullFelic, 32, 48, SSD1306_WHITE);
      break;

    case SON:
      if (expressioActual != expressioAnterior) Serial.println("Estat: Zzz...");
      digitalWrite(LED_R, LOW); digitalWrite(LED_G, LOW); digitalWrite(LED_B, HIGH); // Blau fosc
      display.drawBitmap(ULL_ESQUERRE_X, ULLS_Y, ullSon, 32, 48, SSD1306_WHITE);
      display.drawBitmap(ULL_DRET_X, ULLS_Y, ullSon, 32, 48, SSD1306_WHITE);
      break;

    case TRIST:
      if (expressioActual != expressioAnterior) Serial.println("Estat: TRIST");
      digitalWrite(LED_R, HIGH); digitalWrite(LED_G, LOW); digitalWrite(LED_B, HIGH); // lila
      display.drawBitmap(ULL_ESQUERRE_X, ULLS_Y, ullTristE, 32, 48, SSD1306_WHITE);
      display.drawBitmap(ULL_DRET_X, ULLS_Y, ullTristD, 32, 48, SSD1306_WHITE);
      break;
      
    case SOSPITOS:
      if (expressioActual != expressioAnterior) Serial.println("Estat: SOSPITOS");
      digitalWrite(LED_R, HIGH); digitalWrite(LED_G, LOW); digitalWrite(LED_B, HIGH);
      display.drawBitmap(ULL_ESQUERRE_X, ULLS_Y, ullSquint, 32, 48, SSD1306_WHITE);
      display.drawBitmap(ULL_DRET_X, ULLS_Y, ullNormal, 32, 48, SSD1306_WHITE);
      break;

    case SORPRES:
      if (expressioActual != expressioAnterior) Serial.println("Estat: SORPRES");
      digitalWrite(LED_R, HIGH); digitalWrite(LED_G, HIGH); digitalWrite(LED_B, HIGH); // Blanc
      display.drawBitmap(ULL_ESQUERRE_X, ULLS_Y, ullSorpres, 32, 48, SSD1306_WHITE);
      display.drawBitmap(ULL_DRET_X, ULLS_Y, ullSorpres, 32, 48, SSD1306_WHITE);
      break;

    // --- NOVES EXPRESSIONS INTEGRADES ---
    case PENSANT:
      if (expressioActual != expressioAnterior) Serial.println("Estat: PENSANT (Processant...)");
      digitalWrite(LED_R, LOW); digitalWrite(LED_G, HIGH); digitalWrite(LED_B, HIGH); // Cian / Blau cel
      display.drawBitmap(ULL_ESQUERRE_X, ULLS_Y, ullPensant, 32, 48, SSD1306_WHITE);
      display.drawBitmap(ULL_DRET_X, ULLS_Y, ullPensant, 32, 48, SSD1306_WHITE);
      break;

    case WINK:
      if (expressioActual != expressioAnterior) Serial.println("Estat: WINK (Picada d'ullet)");
      digitalWrite(LED_R, HIGH); digitalWrite(LED_G, LOW); digitalWrite(LED_B, HIGH); // Magenta
      // Combinem ull dret feliç i ull esquerre tancat (parpelleig) per fer l'asimetria
      display.drawBitmap(ULL_ESQUERRE_X, ULLS_Y, ullParpelleig, 32, 48, SSD1306_WHITE);
      display.drawBitmap(ULL_DRET_X, ULLS_Y, ullFelic, 32, 48, SSD1306_WHITE);
      break;

    case MAREJAT:
      if (expressioActual != expressioAnterior) Serial.println("Estat: MAREJAT / ERROR");
      digitalWrite(LED_R, HIGH); digitalWrite(LED_G, LOW); digitalWrite(LED_B, LOW); // Vermell d'alerta
      display.drawBitmap(ULL_ESQUERRE_X, ULLS_Y, ullMarejat, 32, 48, SSD1306_WHITE);
      display.drawBitmap(ULL_DRET_X, ULLS_Y, ullMarejat, 32, 48, SSD1306_WHITE);
      break;
  }

  expressioAnterior = expressioActual;
  display.display(); 
}